# wb_bootrom: IP-XACT component
VLNV librecores.org:ip:wb_bootrom:0.9

## Parameters
DEPTH = 0 — Memory size in bytes
MEMFILE = "" — Initialization file ($readmemh format)

## Bus interfaces (logical=physical port)
wb: mirroredMaster librecores.org:wishbone:wishbone:b3
  adr_o[31:0]=wb_adr_i[31:0], cyc_o[0:0]=wb_cyc_i[0:0], stb_o[0:0]=wb_stb_i[0:0], dat_i[31:0]=wb_dat_o[31:0], ack_i[0:0]=wb_ack_o[0:0]
wb_sys: mirroredMaster librecores.org:misc:clk_rst:0
  clk[0:0]=wb_clk_i[0:0], rst[0:0]=wb_rst_i[0:0]

## Ports
in wb_clk_i
in wb_rst_i
in wb_adr_i[31:0]
in wb_cyc_i
in wb_stb_i
out wb_dat_o[31:0]
out wb_ack_o

## Address spaces and blocks
testmap.testblock: base 'h0, range 4, width 32

## Registers
Registers are 32-bit, access not given, no defined reset value unless marked. A register's access mark holds for its fields unless they carry their own. Offsets are from the block's base; lines under a group give offsets from that group; [hi:lo] are bit positions; {n}, {i} and the like mark numbered series; 'fields as' and 'values as' point back to an identical list; <NAME> marks a mode.

## testmap.testblock
Base 0x00000000
0x00 testreg
